## files/platform-2.0.0/Kconfig
```kconfig
menu "Showay Platform Config"     

menuconfig ARCH
	bool "arch"
	default y
	if ARCH               
		choice                            
			prompt "bsp Select"  
			default ARCH_ARM64    
				
			config ARCH_ARM64      
				bool "arm64"
				select ARCH_ARM
				
			config ARCH_ARM32      
				bool "arm32"	
				select ARCH_ARM
				
			config ARCH_X86_64
				bool "x86_64"
				select ARCH_X86
				
			config ARCH_X86_32
				bool "x86_32"	
				select ARCH_X86
				
		endchoice
		
		choice                            
			prompt "Xilinx Arch Select"  
			default XILINX_ARCH_ZYNQMP    

			config XILINX_ARCH_ZYNQMP      
				bool "zynqmp"
				depends on !X86_64

			config XILINX_ARCH_ZYNQ
				bool "zynq"	
				depends on !X86_64
		endchoice 

		config CROSS_COMPILE
		string "Cross-compiler tool prefix"
		help
		  Same as running 'make CROSS_COMPILE=prefix-' but stored for
		  default make runs in this kernel build directory.  You don't
		  need to set this unless you want the configured kernel build
		  directory to select the cross-compiler automatically.
	endif
	config ARCH_ARM
        bool
	config ARCH_X86
        bool
	

menu "Platform Function Module"   #定义2级菜单
	
    source "main/bsp/Kconfig"
	source "main/dao/Kconfig"
	source "main/device/Kconfig"
	source "main/executor/Kconfig"
	source "main/fs/Kconfig"
	source "main/net/Kconfig"
endmenu                             # 2级菜单的结束

menu "Others" 

config CALIBRATION_GAIN
	bool "Calibration Gain"
	default n
	
config RESIDENCY_STRATEGY
	bool "Signal Residency Strategy"
	default n	
	help
		The Residency Strategy takes effect in multi frequency mode!!
		
config LOCAL_CTRL_EN
	bool "Enable Remote or Local Control"
	default n

config SSDP
        bool "Enable SSDP"
        default y

config JQ
        bool "Enable JSON JQ"
        default y
		
config SYSLOG
	bool "SysLog"
	default y

config NRS1800
        bool "Enable NRS1800"
        default n
endmenu   

menu "Compile Selection" 
config DEPENDS_LIB
	string "petalinux depends lib"
	default ""
	
config LINK_LIB
	string "link lib"
	default ""
endmenu
	
endmenu
```

## files/platform-2.0.0/main/Kconfig
```kconfig
#
# For a description of the syntax of this configuration file,
# see Documentation/kbuild/kconfig-language.txt.
#

source "main/bsp/Kconfig"
source "main/dao/Kconfig"

#config DEVICE
#    bool "device"
#	default y
	
#if DEVICE
source "main/device/Kconfig"
#endif
```

## files/platform-2.0.0/main/bsp/Kconfig
```kconfig
#
# For a description of the syntax of this configuration file,
# see Documentation/kbuild/kconfig-language.txt.
#
menuconfig BSP
	bool "BSP"
	default y
	if BSP               #条件判断
		choice                            #选择配置项，其值可选，类似单选框功能
			prompt "Select bsp"  #配置项的显示名称
			default BSP_DEMO     #默认选择的配置

			config BSP_DEMO      #配置选项
				bool "demo"

			config BSP_WD_XCR
				bool "wd_xcr"
				
			config BSP_40G
				bool "40g"
				
			config BSP_SSA_MONITOR
				bool "ssa monitor"
			
			config BSP_SSA
				bool "ssa"
				
			config BSP_TF713_4CH
				bool "tf713_4ch"

			config BSP_TF713_2CH
				bool "tf713_2ch"
				
			config BSP_YF21015
				bool "yf21015"
				
			config BSP_YF21025
				bool "yf21025"
			config BSP_YF21033
				bool "yf21033"
		endchoice                         #结束选择配置项
		
	config BSP_NAME
		string "Bsp Name"
		default "yf21025"
	
	config FPGA_REGISTER
		bool "Fpga Register"
		default n
		
	config IF_FPGA_REGISTER
		bool "IF Fpga Register"
		default y
		depends on FPGA_REGISTER
		
	config RF_FPGA_REGISTER
		bool "RF Fpga Register"
		default y
		depends on FPGA_REGISTER

	endif
```

## files/platform-2.0.0/main/dao/Kconfig
```kconfig
#
# For a description of the syntax of this configuration file,
# see Documentation/kbuild/kconfig-language.txt.
#
menuconfig DAO
	bool "Config Data Access(Dao)"
	default y
	if DAO               #条件判断
		choice                            #选择配置项，其值可选，类似单选框功能
			prompt "Select data access"  #配置项的显示名称
			default DAO_JSON     #默认选择的配置

			config DAO_JSON      #配置选项
				bool "json"

			config DAO_XML
				bool "xml"	
		endchoice                         #结束选择配置项
	endif
```

## files/platform-2.0.0/main/device/Kconfig
```kconfig
#
# For a description of the syntax of this configuration file,
# see Documentation/kbuild/kconfig-language.txt.
#
menuconfig USER_DEVICE
        bool "User Device Select"
        default y
        if USER_DEVICE
            config DEVICE_AUDIO
                bool "Audio"
                default n

            config DEVICE_ADC_CLOCK
                bool "Adc&Clock"
                default y
                
            config DEVICE_GPIO
                bool "Gpio"
                default y

            config DEVICE_GPS
                bool "GPS"
                default n  
                
            config DEVICE_LCD
                bool "LCD"
                default n
                
            config DEVICE_UART
                bool "UART"
                default n        

            config DEVICE_RS485
                bool "RS485"
                select DEVICE_UART
                default n
				
			config DEVICE_RS485_AMP
                bool "RS485 Amplifier"
                select DEVICE_UART
                default n
				depends on DEVICE_RS485
			
			config DEVICE_RS485_EC
                bool "RS485 Electronic Compass"
                select DEVICE_UART
                default n
				depends on DEVICE_RS485
                
            config DEVICE_HUMIDITY
                bool "Humity"
                default n  
	
		    menuconfig DEVICE_RF  
			#config DEVICE_RF			
			bool "RF"
			default y		   
			if DEVICE_RF               
				choice                            
					prompt "RF Control Select"  
					default DEVICE_RF_FPGA  
					
					config DEVICE_RF_FPGA     
					bool "FPGA register"
					
					#menuconfig DEVICE_RF_SPI 					
					config DEVICE_RF_SPI      
					bool "SPI Protocol Enable"
					
					if DEVICE_RF_SPI
						choice 
							prompt "SPI Protocol Select"  
							default DEVICE_RF_SPI_TF713

							config DEVICE_RF_SPI_TF713     
							bool "tf713"
							
							config DEVICE_RF_SPI_ACT     
							bool "act"
						endchoice  						
					endif
						
					config DEVICE_RF_ADRV
					bool  "Chip &GPIO Control"
					
					menuconfig DEVICE_RF_ADRV_CONDITION 
					#config DEVICE_RF_ADRV_CONDITION 
						bool "GPIO Control(Condition Module)"	
						default y
						depends on DEVICE_RF_ADRV && DEVICE_RF_ADRV
					if DEVICE_RF_ADRV_CONDITION
						choice 
							prompt "Condition"  
							default DEVICE_RF_ADRV_CONDITION_GPIO

							config DEVICE_RF_ADRV_CONDITION_GPIO     
							bool "GPIO"
							
							config DEVICE_RF_ADRV_CONDITION_SPI     
							bool "SPI"
						endchoice  						
					endif
						
					if DEVICE_RF_ADRV
						choice 
							prompt "AD/RF Chip Select "  
							default DEVICE_RF_ADRV_9009

							config DEVICE_RF_ADRV_9009     
							bool "ADRV9009"
							
							config DEVICE_RF_ADRV_9361     
							bool "ADRV9361"
						endchoice 						
					endif
				endchoice                        
			endif
        endif
```

## files/platform-2.0.0/main/device/rf/Kconfig
```kconfig
#
# For a description of the syntax of this configuration file,
# see Documentation/kbuild/kconfig-language.txt.
#
choice
    prompt "rf control"
    optional

config DEVICE_RF_FPGA
    bool "fpga"
	default y

config DEVICE_RF_SPI
    bool "spi"
if DEVICE_RF_SPI
	source "main/device/rf/spi/Kconfig"
endif

config DEVICE_RF_ADRV
    bool "adrv"
if DEVICE_RF_ADRV
	source "main/device/rf/adrv/Kconfig"
endif
	
endchoice
```

## files/platform-2.0.0/main/device/rf/adrv/Kconfig
```kconfig
#
# For a description of the syntax of this configuration file,
# see Documentation/kbuild/kconfig-language.txt.
#
choice
    prompt "adrv"
    optional

config DEVICE_RF_ADRV_9009
    bool "adrv9009"

config DEVICE_RF_ADRV_9361
    bool "adrv9361"
	
endchoice

config DEVICE_RF_ADRV_CONDITION
    bool "condition control"
	if DEVICE_RF_ADRV_CONDITION
		source "main/device/rf/condition/Kconfig"
	endif

config DEVICE_RF_ADRV_HOP_FREQ
    bool "Frequency Hop"
	default n
```

## files/platform-2.0.0/main/device/rf/adrv/condition/Kconfig
```kconfig
#
# For a description of the syntax of this configuration file,
# see Documentation/kbuild/kconfig-language.txt.
#
choice
    prompt "condition"
    optional

config DEVICE_RF_ADRV_CONDITION_GPIO
    bool "gpio"

config CONFIG_DEVICE_RF_ADRV_CONDITION_SPI
    bool "spi"
	
endchoice
```

## files/platform-2.0.0/main/device/rf/spi/Kconfig
```kconfig
#
# For a description of the syntax of this configuration file,
# see Documentation/kbuild/kconfig-language.txt.
#
choice
    prompt "rf spi protocol"
    optional

config DEVICE_RF_SPI_ACT
    bool "act"

config DEVICE_RF_SPI_TF713
    bool "tf713"

endchoice
```

## files/platform-2.0.0/main/executor/Kconfig
```kconfig
#
# For a description of the syntax of this configuration file,
# see Documentation/kbuild/kconfig-language.txt.
#
menu "Spectrum Function"


		
menuconfig SPM
	bool "Enable Spectrum"
	default y
	
	if SPM               
		choice 
			prompt "Spectrum Source Select"  
			default SPM_SOURCE_FPGA	
			
			config SPM_SOURCE_FPGA      
				bool "FPGA DMA"

			config SPM_SOURCE_CHIP
				bool "chip(adrv90xx)"
				
			config SPM_SOURCE_X86
				bool "X86 Demo"
			config SPM_SOURCE_XDMA
				bool "XDMA"
		endchoice                         
	endif
	
	config SPM_DISTRIBUTOR
        bool "FFT Distributor"
        default n
		depends on SPM
		
	config SPM_FFT_CONTINUOUS_MODE
        bool "FFT Continuous Mode"
        default n
		depends on SPM
	
	config SPM_FFT_WINDOWS
        bool "Windows"
        default n
		depends on SPM && SPM_SOURCE_FPGA
		
	config SPM_FFT_AGC
        bool "AGC"
        default n
		depends on SPM && SPM_SOURCE_FPGA
		
	config SPM_FFT_EXTRACT_POINT
        bool "Extrace Point"
        default n
		depends on SPM && SPM_SOURCE_FPGA
		
	config SPM_FFT_BOTTOM
        bool "FFT Bottom calibration"
        default n
		depends on SPM
		
	config SPM_FFT_SCAN_SEGMNET
        bool "FFT Scan Frequency Segmentation"
        default n
		depends on SPM && SPM_SOURCE_FPGA
		
	config SPM_FFT_IQ_CONVERT
        bool "IQ -> FFT convert"
	    select LIBIIO 
        select LIBFFTW3
        default n
		depends on SPM
    
	config SPM_FFT_SIGNAL_ANALYSIS
        bool "FFT analysis"
        default n
		depends on SPM && SPM_SOURCE_CHIP && SPM_FFT_IQ_CONVERT
	
	config SPM_FFT_BY_RESOLUTION
        bool "Get FFT Size by Resolution"
        default n
		depends on SPM
	
	config SPM_FFT_PACKAGING_PROCESS
        bool "FFT Packaging Processing"
        default n
		depends on SPM
		
	config SPM_FFT_CONTROL	
		bool "FFT Thread Control"
		depends on SPM && SPM_SOURCE_FPGA
		if SPM_FFT_CONTROL               
			choice 
				prompt "FFT Thread Control Select"  
				default SPM_FFT_PARALLEL	
				
				config SPM_FFT_PARALLEL    
					bool "Parallel Control"

				config SPM_FFT_SERIAL
					bool "Serial Control"
			endchoice                         
		endif
	
	config LIBIIO
        bool
        default n

    config LIBFFTW3
        bool
        default n	
	
endmenu
	
```

## files/platform-2.0.0/main/fs/Kconfig
```kconfig
#
# For a description of the syntax of this configuration file,
# see Documentation/kbuild/kconfig-language.txt.
#
config FS
	bool "File & Disk Management"
	default n
	
config FS_FORMAT_WAV
	bool "Format Wav"
	default n
	depends on FS
	
config FS_NOTIFIER
	bool "Notify"
	default n
	depends on FS
	
config FS_PROGRESS
	bool "Progress"
	default n
	depends on FS
	
config FS_PAUSE
	bool "Pause"
	default n
	depends on FS
	
config FS_SAVE_PAUSE
	bool "Save Pause"
	default n
	depends on FS_PAUSE
	
config FS_BACK_PAUSE
	bool "BackTrace Pause"
	default n
	depends on FS_PAUSE
	
menuconfig FS_FILENAME_RULE
	bool "File Naming Rule"
	default y
	depends on FS
	if FS_FILENAME_RULE
	choice
		prompt "Select File Naming Rule"
		default FS_FILENAME_RULE_TF713
		
		config FS_FILENAME_RULE_TF713
		bool "TF713"
		
		config FS_FILENAME_RULE_ACT
		bool "ACT"
	endchoice
	endif
```

## files/platform-2.0.0/main/net/Kconfig
```kconfig
menuconfig NET
	bool "Application Net"
	default y
		config NET_NUMBERS
			int "Number of network nodes"
			default 2  
			depends on NET	
			
		config NET_10G
			bool "Net 10G"
			default n  
			depends on NET	
			
		config NET_10G_IFNAME
			string "ifname"
			default "eth0"
		depends on NET_10G && NET

		config NET_1G
			bool "Net 1G"
			default y  
			depends on NET
			
		config NET_1G_IFNAME
			string "ifname"
			default "eth1"
			depends on NET_1G && NET
			
		source "main/protocol/Kconfig"
```

## files/platform-2.0.0/main/protocol/Kconfig
```kconfig
#
# For a description of the syntax of this configuration file,
# see Documentation/kbuild/kconfig-language.txt.
#
menuconfig PROTOCOL
	bool "Application Net Protocol"
	default y
	depends on NET
	if PROTOCOL               
		choice                            
			prompt "Protocol Select"  
			default PROTOCOL_XW     

			config PROTOCOL_XW      
				bool "showay"

			config PROTOCOL_ACT
				bool "act"	
		endchoice                         
	endif
	
	if PROTOCOL               
		choice                            
			prompt "Data Protocol Select"  
			default PROTOCOL_DATA_TCP     

			config PROTOCOL_DATA_TCP      
				bool "tcp"

			config PROTOCOL_DATA_UDP
				bool "udp"	
		endchoice                         
	endif

	config PROTOCOL_CLINET_SUB_DATA
        bool "Client Sub Data Type"
        default n
		depends on PROTOCOL
		
	config PROTOCOL_HTTP_PORT
        int "HTTP Port"
        default 80
		depends on PROTOCOL
	
	config PROTOCOL_FTP
        bool "Use FTP to Tranfer Data"
        default n
		depends on PROTOCOL
		
	config PROTOCOL_FTP_PORT
        int "FTP Port"
        default 8000
		depends on PROTOCOL_FTP

	config PROTOCOL_FTP_PATH
	string	"Ftp Path"
	default "/home"
	
	
```
